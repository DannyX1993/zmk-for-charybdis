#include "charybdis.dtsi"

&default_transform {
    col-offset = <6>;
};

&kscan0 {
    col-gpios
        = <&gpio0 2 (GPIO_ACTIVE_HIGH | GPIO_PULL_DOWN)>
        , <&gpio0 29 (GPIO_ACTIVE_HIGH | GPIO_PULL_DOWN)>
        , <&gpio0 9 (GPIO_ACTIVE_HIGH | GPIO_PULL_DOWN)>
        , <&gpio1 0  (GPIO_ACTIVE_HIGH | GPIO_PULL_DOWN)>
        , <&gpio0 11 (GPIO_ACTIVE_HIGH | GPIO_PULL_DOWN)>
        , <&gpio1 4  (GPIO_ACTIVE_HIGH | GPIO_PULL_DOWN)>
        ;
};

/* CONFIGURACIÓN CLÁSICA (SPI DIRECTO) */
&spi0 {
    status = "okay";
    compatible = "nordic,nrf-spim";
    /* Pines directos (sin pinctrl) */
    sck-pin = <8>;
    mosi-pin = <17>;
    miso-pin = <17>;
    cs-gpios = <&gpio0 20 GPIO_ACTIVE_LOW>;

    trackball: trackball@0 {
        status = "okay";
        compatible = "pixart,pmw3610";
        reg = <0>;
        spi-max-frequency = <2000000>;
        
        /* En la v3.5 se usa 'irq', no 'motion' */
        irq-gpios = <&gpio0 6 (GPIO_ACTIVE_LOW | GPIO_PULL_UP)>;
        
        /* Y aquí SÍ funcionan estas opciones */
        scroll-layers = <2>;
    };
};