## config/west.yml
```yaml
manifest:
  remotes:
    - name: zmkfirmware
      url-base: https://github.com/zmkfirmware
    - name: bastardkb
      url-base: https://github.com/Bastardkb
  projects:
    - name: zmk
      remote: bastardkb
      revision: main
      import: app/west.yml
  self:
    path: config
```
